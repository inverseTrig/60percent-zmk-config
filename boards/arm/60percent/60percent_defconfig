## boards/arm/60percent/60percent_defconfig
```kconfig
# SPDX-License-Identifier: MIT

CONFIG_SOC_SERIES_NRF52X=y
CONFIG_SOC_NRF52840_QIAA=y
CONFIG_BOARD_60PERCENT=y

# Enable MPU
CONFIG_ARM_MPU=y

# enable GPIO
CONFIG_GPIO=y

CONFIG_ZMK_SLEEP=y

CONFIG_USE_DT_CODE_PARTITION=y
CONFIG_BUILD_OUTPUT_UF2=y

CONFIG_MPU_ALLOW_FLASH_WRITE=y
CONFIG_NVS=y
CONFIG_SETTINGS_NVS=y
CONFIG_FLASH=y
CONFIG_FLASH_PAGE_LAYOUT=y
CONFIG_FLASH_MAP=y

# Power Management
CONFIG_ZMK_SLEEP=y
CONFIG_ZMK_IDLE_TIMEOUT=30000
CONFIG_ZMK_IDLE_SLEEP_TIMEOUT=900000

# Enable NKRO
CONFIG_ZMK_HID_REPORT_TYPE_NKRO=y

# Increase Bluetooth transmit power
CONFIG_BT_CTLR_TX_PWR_PLUS_8=y
```

## boards/arm/60percent/Kconfig.board
```kconfig
# 60percent board configuration

# Copyright (c) 2023 HeeChan Kang
# SPDX-License-Identifier: MIT

config BOARD_60PERCENT
    bool "ILabs Challenger 840"
    depends on SOC_NRF52840_QIAA
```

## boards/arm/60percent/Kconfig.defconfig
```kconfig
# Copyright (c) 2023 HeeChan Kang
# SPDX-License-Identifier: MIT

if BOARD_60PERCENT

config BOARD
    default "60percent"

config ZMK_KEYBOARD_NAME
    default "60percent"

if USB

config USB_NRFX
    default y

config USB_DEVICE_STACK
    default y

endif # USB

config BT_CTLR
    default BT

config ZMK_BLE
    default y

config ZMK_USB
    default y

endif # BOARD_60PERCENT
```
